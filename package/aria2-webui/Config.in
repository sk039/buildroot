## package/aria2-webui/Config.in
```kconfig
config BR2_PACKAGE_ARIA2_WEBUI
	bool "aria2-webui"
    depends on BR2_PACKAGE_UHTTPD
	help
	  Aria2 WebUI.

	  https://github.com/ziahamza/webui-aria2
```

## package/aria2/Config.in
```kconfig
config BR2_PACKAGE_ARIA2
	bool "aria2"
	depends on BR2_TOOLCHAIN_HAS_THREADS
	depends on BR2_USE_MMU # fork()
	depends on BR2_INSTALL_LIBSTDCPP
	select BR2_PACKAGE_ZLIB
	select BR2_PACKAGE_OPENSSL
	help
	  Aria2 is a lightweight download utility

	  https://github.com/aria2/aria2

if BR2_PACKAGE_ARIA2

config BR2_PACKAGE_ARIA2_BITTORRENT
	bool "Enable Bittorrent Support"
    depends on BR2_PACKAGE_OPENSSL || BR2_PACKAGE_LIBGCRYPT || \
        (BR2_PACKAGE_NETTLE && BR2_PACKAGE_GMP)
    default y
	help
	  Support for Bittorrent.

config BR2_PACKAGE_ARIA2_METALINK
	bool "Enable Metalink Support"
    default n
    depends on BR2_PACKAGE_LIBXML2 || BR2_PACKAGE_EXPAT
	help
	  Support for Metalink.

config BR2_PACKAGE_ARIA2_SFTP
	bool "Enable SFTP Support"
    default n
    depends on BR2_PACKAGE_LIBSSH2
	help
	  Support for SFTP.

config BR2_PACKAGE_ARIA2_ASYNC_DNS
	bool "Enable Async DNS Support"
    default n
    depends on BR2_PACKAGE_C_ARES
	help
	  Support for Async DNS.

config BR2_PACKAGE_ARIA2_COOKIE
	bool "Enable Firefox3/Chromium Cookie Support"
    default n
    depends on BR2_PACKAGE_SQLITE
	help
	  Support for Firefox3/Chromium Cookie.

config BR2_PACKAGE_ARIA2_WEBSOCKET
	bool "Enable JSON-RPC Over WebSocket Support"
    default y
    depends on BR2_PACKAGE_OPENSSL || BR2_PACKAGE_LIBGCRYPT || \
        BR2_PACKAGE_NETTLE
	help
	  Support for JSON-RPC over WebSocket.

endif

comment "Aria2 needs a toolchain w/ C++"
	depends on !BR2_INSTALL_LIBSTDCPP

comment "transmission needs a toolchain w/ threads"
	depends on BR2_USE_MMU
	depends on !BR2_TOOLCHAIN_HAS_THREADS
```
